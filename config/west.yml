## config/west.yml
```yaml
manifest:
  remotes:
    - name: darknao
      url-base: https://github.com/darknao
  projects:
    - name: zmk
      remote: darknao
      revision: zmk-perkey_ug
      import: app/west.yml
  self:
    path: boards
```
